## conf/layer.conf
```bitbake
# We have a conf and classes directory, add to BBPATH
BBPATH .= ":${LAYERDIR}"

# We have recipes-* directories, add to BBFILES
BBFILES += "${LAYERDIR}/recipes-*/*/*.bb \
            ${LAYERDIR}/recipes-*/*/*.bbappend"

BBFILE_COLLECTIONS += "meta-mathworks"
BBFILE_PATTERN_meta-mathworks= "^${LAYERDIR}/"
BBFILE_PRIORITY_meta-mathworks = "6"
IMAGE_INSTALL_append_zynqmp = "mw-fs-overlay-zynqmp"

LAYERDEPENDS_meta-mathworks = "core"
LAYERSERIES_COMPAT_meta-mathworks = "thud"
```
